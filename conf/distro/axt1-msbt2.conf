## conf/distro/include/tplatforms-sdk-sources.inc
```bitbake
#
# T-platforms SDK version
#
# SDK version is statically set here so to have at least some value used
# by SDK-specific meta code.
#
TPSDK_VERSION ?= "2.0"
TPSDK_REVISION ?= "0"

#
# Yocto SDK settings
#
# SDK is suppose to run on x86_64 machines only, since pre-built toolchain
# got that cpu architecure..
# We need to set the common SDK parameters like its full name and default
# installation path. In addition we need to have flashrom and openocd
# natively installed, so the users could burn and debug the firmware.
# We also want the toolchain and debugger being included to the Extensible
# SDK by setting type to full in opposite to minimal. The kernel
# sources and headers, flashrom and openocd, static packages are included
# to the SDK as well.
#
SDKMACHINE = "x86_64"
SDK_VENDOR = "-tpsdk"
SDK_VERSION := "${TPSDK_VERSION}"
SDK_NAME = "${IMAGE_BASENAME}-${SDK_ARCH}-${TUNE_PKGARCH}"
SDKPATH = "/opt/${DISTRO}${SDK_VENDOR}/${SDK_VERSION}"
SDK_EXT_TYPE = "full"
#SDKIMAGE_FEATURES_append = " staticdev-pkg"
TOOLCHAIN_HOST_TASK_append = " nativesdk-flashrom nativesdk-openocd nativesdk-recovery-image-info"
TOOLCHAIN_TARGET_TASK_append = " kernel-devsrc"

#
# Default kernel/bootloader code source
#
# The setting is responsible for selecting the kernel and bootloader code
# source. When this BSP is used as part of archived distribution, it is supplied
# with locally fetched sources near the yocto directory, so there is no need
# to have it downloaded from remote resources. But for development and debug
# purpose they'd better to be fetched from corresponding repositories.
#
TPSDK_SYS ?= "mipsel-unknown-linux-gnu"
TPSDK_DIR ?= "/media/windows/WORKSPACE/IT/T-platforms/SFBT1/src/sdk"
TPSDK_SRC ?= "sdk"
TPSDK_XTC ?= "sdk"
TPSDK_KEYS_NAME ?= "baikal"
TPSDK_KERNEL_DIR ?= "${TPSDK_DIR}/kernel"
TPSDK_UBOOT_DIR ?= "${TPSDK_DIR}/u-boot"
TPSDK_KEYS_DIR ?= "${TPSDK_DIR}/keys"
TPSDK_XTOOLS_DIR ?= "${TPSDK_DIR}/x-tools"

#
# Validate the settings supplied in the section above
#
# We need to validate wether the sources are selected correctly, the SDK
# directory exists if locally sourced. If it does, then we'll determine
# the kernel and u-boot versions stright from makefiles.
#
python tpsdk_check_settings () {
    tpsdksrc = d.getVar("TPSDK_SRC", True)
    tpsdkxtc = d.getVar("TPSDK_XTC", True)

    if tpsdksrc == "sdk" or tpsdkxtc == "sdk":
        tpsdkdir = d.getVar("TPSDK_DIR", True)
        if not os.path.exists(tpsdkdir):
            bb.fatal("T-platforms SDK directory '%s' doesn't exist" % tpsdkdir)

    # Check T-platforms sources parameters and set corresponding override
    if tpsdksrc == "sdk":
        tpsdkdir = d.getVar("TPSDK_KERNEL_DIR", True)
        ver = tpsdk_get_src_version(d, tpsdkdir, "Makefile")
        d.setVar("PREFERRED_VERSION_linux-baikal", ver + r"%")

        tpsdkdir = d.getVar("TPSDK_UBOOT_DIR", True)
        ver = tpsdk_get_src_version(d, tpsdkdir, "Makefile")
        d.setVar("PREFERRED_VERSION_u-boot-baikal", ver)

        d.prependVar("DISTROOVERRIDES", "tpsdksrc:")

    elif tpsdksrc == "git":
        d.prependVar("DISTROOVERRIDES", "tpgitsrc:")

    else:
        bb.fatal("TPSDK_SRC value shall be one of {sdk,git}, but it is '%s'" % tpsdksrc)

    # Set T-platforms X-toolchain override settings
    if tpsdkxtc == "sdk":
        d.prependVar("DISTROOVERRIDES", "tpsdkxtc:")
    elif tpsdkxtc == "git":
        d.prependVar("DISTROOVERRIDES", "tpgitxtc:")
    else:
        bb.fatal("TPSDK_XTC value shall be one of {sdk,git}, but it is '%s'" % tpsdkxtc)
}
tpsdk_check_settings[eventmask] = "bb.event.ConfigParsed"
addhandler tpsdk_check_settings

def tpsdk_get_src_version (d, srcpath, file):
    import re

    srcpath = os.path.join(srcpath, file)
    if not os.path.exists(srcpath):
        bb.fatal("T-platforms source file '%s' doesn't exist" % srcpath)
        return None

    try:
        f = open(srcpath)
    except IOError:
        bb.fatal("Couldn't open file '%s'" % srcpath)
    else:
        with f:
            lines = f.readlines()

        f.close()

        for line in lines:
            m = re.match(r"^VERSION = (\d{1,})$", line)
            if m:
                ver = m.group(1)
                continue
            m = re.match(r"^PATCHLEVEL = (\d{1,})$", line)
            if m:
                patch = m.group(1)
                break
        if ver and patch:
            return "%s.%s" % (ver,patch)

    bb.fatal("Couldn't extract version from file %s" % srcpath)
    return None
```

## conf/distro/include/tpsdk-config.inc
```bitbake
#
# T-platforms SDK version and sources
#
# SDK version is statically set here so to have at least some value used
# by SDK-specific meta code.
#
TPSDK_VERSION ?= "1.1"
TPSDK_REVISION ?= "0"
TPSDK_RCCYCLE ?= "0"
TPSDK_REPO ?= "gitlab.elpitech.ru"

#
# Yocto SDK settings
#
# We need to set the common SDK parameters like its full name and default
# installation path. In addition we need to have flashrom and openocd
# natively installed, so the users could burn and debug the firmware.
# We also want the toolchain and debugger being included to the Extensible
# SDK by setting type to full in opposite to minimal. The kernel
# sources and headers, flashrom and openocd, static packages are included
# to the SDK as well.
#
SDKMACHINE = "x86_64"
SDK_VENDOR = "-tpsdk"
SDK_VERSION := "${TPSDK_VERSION}.${TPSDK_REVISION}${@'-rc${TPSDK_RCCYCLE}' if '${TPSDK_RCCYCLE}' else ''}"
SDK_NAME = "${DISTRO}-${MACHINE}-${SDK_ARCH}-${TUNE_PKGARCH}"
SDKPATH = "/opt/${DISTRO}-${MACHINE}${SDK_VENDOR}/${SDK_VERSION}"
SDK_EXT_TYPE = "full"
#SDKIMAGE_FEATURES:append = " staticdev-pkg"
SDK_HOST_TOOLCHAIN = " nativesdk-openocd nativesdk-recovery-image-info"
#SDK_TARGET_TOOLCHAIN = " kernel-devsrc"
```

## conf/distro/mitx.conf
```bitbake
#@TYPE: Distro
#@NAME: MITX MIPS
#@DESCRIPTION: Baikal-T1 based T-platforms MITX board

###################################################################################################
#                                   U-boot environment settings
###################################################################################################
UBOOT_ENV_CPUFREQ = "1200"
UBOOT_ENV_BOOTDELAY = "3"
UBOOT_ENV_BOOTCMD = "run bootrecovery"
UBOOT_ENV_INITRD_HIGH = "ffffffff"
UBOOT_ENV_BOOTUNITS = "rec_ram=1. Boot recovery kernel and RFS;rom=initfs;; \
                       reset=Reset board;reset"
UBOOT_ENV_EXTRA_VARS = "bootnormal=gpio clear 18; run sata_boot\n\
bootrecovery=gpio clear 18; run setroot_rec_ram collect_args; sf probe; mtd read fitimage \${multi_addr_ld}; bootm \${multi_addr_ld}\${multi_conf}\n\
multi_addr_ld=85000000\n\
res0=true\nres1=false\nifok=run res\$?\n\
boot_bootconf=run load_bootconf load_fdt load_kernel load_initrd; run ifok all_bootnr\n\
sata_boot=sata init; setenv boot_dev sata; setenv boot_idx 0; run boot_bootconf\n\
usb_boot=usb start; setenv boot_dev usb; setenv boot_idx 0; run boot_bootconf\n\
mmc_speed=10000000\n\
mmc_boot=mmc_spi 0 \${mmc_speed}; setenv boot_dev mmc; setenv boot_idx 0; run boot_bootconf\n\
load_bootconf=load \${boot_dev} \${boot_idx} \${fdt_addr_ld} bootconf; service bootconf \${fdt_addr_ld} \${filesize}\n\
load_kernel=echo Loading kernel: \${kernel_file_name}; load \${boot_dev} \${boot_idx} \${kernel_addr_n} \${kernel_file_name}\n\
load_initrd=echo Loading ramdisk: \${initrd_file_name}; load \${boot_dev} \${boot_idx} \${initrd_addr_ld} \${initrd_file_name}; setenv initrd_len \${filesize}\n\
load_fdt=echo Loading FDT: \${fdt_file_name}; load \${boot_dev} \${boot_idx} \${fdt_addr_ld} \${fdt_file_name}; fdt addr \${fdt_addr_ld}\n\
all_bootnr=bootnr \${kernel_addr_r} \${initrd_addr_ld} \${fdt_addr_ld}"
UBOOT_ENV_EXTRA_ARGS = "video=sm750fb:800x600-32@60 console=tty2 usbcore.autosuspend=-1 consoleblank=0"

RECOVERY_SETPASS = "y"
SERIAL_CONSOLES = "115200;ttyS0 0;tty2 0;tty3 0;tty4"
RECOVERY_IMAGE_EXTRA_INSTALL:append = " recovery-ui util-linux-uuidgen libmitxfru pigz"
# We will run out of space if we add tcpdump and ntp. Check what can be removed
# in firmware.inc if you really need them.
#RECOVERY_IMAGE_EXTRA_INSTALL:append = " tcpdump ntp"

# Add more tests from firmware.inci, if needed
RECOVERY_IMAGE_TEST_BENCHES = "memtester"

INITRAMFS_MAXSIZE = "44000"

###################################################################################################
#                                     Recovery image settings
###################################################################################################
RECOVERY_PWD_ROOT = "1"
```

## conf/distro/mrbt1.conf
```bitbake
#@TYPE: Distro
#@NAME: MRBT1 MIPS
#@DESCRIPTION: Baikal-T1 based T-platforms MRBT1 module

###################################################################################################
#                                   U-boot environment settings
###################################################################################################
UBOOT_ENV_CPUFREQ = "1200"
```

## conf/distro/msbt2.conf
```bitbake
#@TYPE: Distro
#@NAME: MSBT2 MIPS
#@DESCRIPTION: Baikal-T1 based T-platforms MSBT2 module

###################################################################################################
#                                   U-boot environment settings
###################################################################################################
UBOOT_ENV_CPUFREQ = "1200"
UBOOT_ENV_BOOTDELAY = "10"
UBOOT_ENV_BOOTCMD = "run boot_rec_ram"
UBOOT_ENV_BOOTUNITS = "\
	rec_ram=1.  Boot from flash to initrd;rom=initfs;; \
	rec_sda1=2.  Boot from flash to /dev/sda1 FS;rom=/dev/sda1;; \
	rec_sdb1=3.  Boot from flash to /dev/sdb1 FS;rom=/dev/sdb1;; \
	usb_ram=4.  Boot from USB 0:1 to initrd;usb=initfs;part=0:1;dir=/;; \
	usb_sda1=5.  Boot from USB 0:1 to /dev/sda1 FS;usb=/dev/sda1;part=0:1;dir=/boot;; \
	usb_sdb1=6.  Boot from USB 1:1 to /dev/sdb1 FS;usb=/dev/sdb1;part=1:1;dir=/boot;; \
	sata_ram=7.  Boot from SATA 0:1 to initrd;usb=initfs;part=0:1;dir=/;; \
	sata_sda1=8.  Boot from SATA 0:1 to /dev/sda1 FS;sata=/dev/sda1;part=0:1;dir=/boot;; \
	sata_sdb1=9.  Boot from SATA 1:1 to /dev/sdb1 FS;sata=/dev/sdb1;part=1:1;dir=/boot;; \
	net_stat=10. Boot via TFTP (192.168.0.2/192.168.0.1) to initrd;tftp=initfs;ip=192.168.0.2;srvip=192.168.0.1;; \
	net_dhcp=11. Boot via TFTP (dhcp/192.168.0.1) to initrd;tftp=initfs;ip=dhcp;srvip=192.168.0.1;; \
	net_nfs=12. Boot via NFS (dhcp/192.168.0.1) to initrd;nfs=initfs;ip=dhcp;srvip=192.168.0.1;dir=/boot;; \
        fdt_std=13. Select MSBT2 board dtb (default);fdt=${@'${KERNEL_DEVICETREE}'.split()[0]};; \
        fdt_xa1=14. Select XA1-MSBT2 board dtb;fdt=${@'${KERNEL_DEVICETREE}'.split()[1]};; \
	reset=Reset board;reset \
"
UBOOT_ENV_MENU_MAIN = "rec_ram;;rec_sda1;;rec_sdb1;;usb_ram;;usb_sda1;;usb_sdb1;; \
                       sata_ram;;sata_sda1;;sata_sdb1;;net_stat;;net_dhcp;;net_nfs;; \
                       fdt_std;;fdt_xa1;;reset"
```

## conf/distro/recovery.conf
```bitbake
DISTRO = "recovery"
DISTRO_NAME = "Baikal-T Recovery Firmware (T-platforms Reference Distro)"
DISTRO_VERSION = "${TPSDK_VERSION}.${TPSDK_REVISION}${@'-rc${TPSDK_RCCYCLE}' if '${TPSDK_RCCYCLE}' else ''}"
DISTRO_CODENAME = "${LAYERSERIES_CORENAMES}"
MAINTAINER = "Sergey Semin <fancer.lancer@gmail.com>"

#
# T-platforms SDK/recovery firmware configurations
#
# Include SDK configurations declared in the Baikal-T distro-specific header
# file. It shall define all the necessary global variables used by the T-platforms
# specific SDK. Additionaly the firmware include file shall help to configure
# the recovery image settings.
#
require conf/distro/include/tpsdk-config.inc
require conf/distro/include/firmware.inc
include conf/distro/${MACHINE}.conf

# This is the target device vendor, and it can be changed within the recipes,
# so don't use it for any constant paths.
TARGET_VENDOR = "-${SOC_FAMILY}"

# We don't use kernel-yocto class since it's overwhelmed with kmeta functions,
# which we really don't need. Additionally we add fitImage class to be part of
# this image, so to use it in recovery-image creation procedure.
KERNEL_CLASSES = " kernel-fitimage "
# We need to have fit image for U-boot recovery firmware
KERNEL_EXTRA_IMAGETYPES ?= ""
KERNEL_IMAGETYPE = ""
KERNEL_IMAGETYPES = "fitImage ${KERNEL_EXTRA_IMAGETYPES}"
# U-boot load addresses are used by the FIT and U-images creators to make
# properly boot the kernel
UBOOT_LOADADDRESS = "${UBOOT_VMLINUZ_LOADADDRESS}"
UBOOT_ENTRYPOINT = "${UBOOT_VMLINUZ_LOADADDRESS}"
UBOOT_ENTRYSYMBOL = ""

# We shall create the cpio.gz initramfs image with distro name as the image suffix
INITRAMFS_EXTRA_FSTYPES ?= ""
INITRAMFS_IMAGE = "baikal-image-recovery"
INITRAMFS_FSTYPES = "cpio.gz ${INITRAMFS_EXTRA_FSTYPES}"

# Setup the U-boot signature keys source directory and keys name. Additionally
# lets copy the u-boot.dtb file to the build directory.
UBOOT_SIGN_KEYDIR = "${TPSDK_KEYS_DIR}"
UBOOT_SIGN_KEYNAME = "${TPSDK_KEYS_NAME}"
UBOOT_MAKE_TARGET = "all u-boot.dtb"

# Baikal-T ROM-image base and symlink names globally declared so other recipes
# like recovery-image-info app could use them.
ROM_BASE_NAME = "recovery-${MACHINE}-${DATETIME}"
ROM_SYMLINK_NAME = "recovery-${MACHINE}"
IMAGE_INFO_BASE_NAME = "image-info-${MACHINE}-${DATETIME}"
IMAGE_INFO_SYMLINK_NAME = "image-info-${MACHINE}"

TCLIBCAPPEND = ""

QEMU_TARGETS ?= "mips mipsel mips64 mips64el"

PREMIRRORS ??= "\
bzr://.*/.*   http://downloads.yoctoproject.org/mirror/sources/ \n \
cvs://.*/.*   http://downloads.yoctoproject.org/mirror/sources/ \n \
git://.*/.*   http://downloads.yoctoproject.org/mirror/sources/ \n \
gitsm://.*/.* http://downloads.yoctoproject.org/mirror/sources/ \n \
hg://.*/.*    http://downloads.yoctoproject.org/mirror/sources/ \n \
osc://.*/.*   http://downloads.yoctoproject.org/mirror/sources/ \n \
p4://.*/.*    http://downloads.yoctoproject.org/mirror/sources/ \n \
svn://.*/.*   http://downloads.yoctoproject.org/mirror/sources/ \n"

MIRRORS =+ "\
ftp://.*/.*      http://downloads.yoctoproject.org/mirror/sources/ \n \
http://.*/.*     http://downloads.yoctoproject.org/mirror/sources/ \n \
https://.*/.*    http://downloads.yoctoproject.org/mirror/sources/ \n"

# The CONNECTIVITY_CHECK_URI's are used to test whether we can succesfully
# fetch from the network (and warn you if not). To disable the test set
# the variable to be empty.
# Git example url: git://git.yoctoproject.org/yocto-firewall-test;protocol=git;rev=master
CONNECTIVITY_CHECK_URIS ?= "https://www.example.com/"

SANITY_TESTED_DISTROS ?= " \
            ubuntu-15.04 \n \
            ubuntu-16.04 \n \
            ubuntu-16.10 \n \
            ubuntu-17.04 \n \
            debian-8 \n \
            debian-9 \n \
            opensuse-42.1 \n \
            opensuse-42.2 \n \
            "

# QA check settings - a little stricter than the OE-Core defaults
WARN_TO_ERROR_QA = "already-stripped compile-host-path install-host-path \
                    installed-vs-shipped ldflags pn-overrides rpaths staticdev \
                    useless-rpaths"
WARN_QA_remove = "${WARN_TO_ERROR_QA}"
ERROR_QA_append = " ${WARN_TO_ERROR_QA}"

require conf/distro/include/no-static-libs.inc

# Use pre-built libc library so speed the process up
require conf/distro/include/yocto-uninative.inc
INHERIT += "uninative"
```
