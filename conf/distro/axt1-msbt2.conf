## conf/distro/rt1mb.conf
```bitbake
#@TYPE: Distro
#@NAME: RT1MB MIPS
#@DESCRIPTION: Baikal-T1 based T-platforms RT1MB board

###################################################################################################
#                                   U-boot environment settings
###################################################################################################
UBOOT_ENV_CPUFREQ = "1200"
UBOOT_ENV_BOOTDELAY = "3"
UBOOT_ENV_BOOTCMD = "run boot_rec_ram"
UBOOT_ENV_BOOTUNITS = "\
	rec_ram=1. Boot from flash to SPI-flash;rom=initfs;; \
	rec_sda6=2. Boot from flash to /dev/sda6 FS;rom=/dev/sda6;; \
	rec_sdb1=3. Boot from flash to /dev/sdb1 FS;rom=/dev/sdb1;; \
	usb_ram=4. Boot from USB 0:1 to recovery FS;usb=initfs;part=0:1;dir=/boot;; \
	usb_sdb1=5. Boot from USB 0:1 to /dev/sdb1 FS;usb=/dev/sdb1;part=0:1;dir=/boot;; \
	sata_sdb1=6. Boot from SATA 1:1 to /dev/sdb1 FS;sata=/dev/sdb1;part=0:1;dir=/boot;; \
	reset=Reset board;reset \
"
UBOOT_ENV_MENU_MAIN = "rec_ram;;rec_sda6;;rec_sdb1;; \
			usb_ram;;usb_sdb1;;sata_sdb1;; \
			reset"
```

## conf/distro/sfbt1.conf
```bitbake
#@TYPE: Distro
#@NAME: SFBT1 MIPS
#@DESCRIPTION: Baikal-T based T-platforms SFBT1 module

###################################################################################################
#                                   U-boot environment settings
###################################################################################################
UBOOT_ENV_CPUFREQ = "850"
UBOOT_ENV_BOOTDELAY = "10"
UBOOT_ENV_BOOTCMD = "run boot_rec_ram"
UBOOT_ENV_BOOTUNITS = "\
	rec_ram=1.  Boot from flash to initrd;rom=initfs;; \
	rec_sda1=2.  Boot from flash to /dev/sda1 FS;rom=/dev/sda1;; \
	rec_sdb1=3.  Boot from flash to /dev/sdb1 FS;rom=/dev/sdb1;; \
	usb_ram=4.  Boot from USB 1:1 to initrd;usb=initfs;part=1:1;dir=/;; \
	usb_sda1=5.  Boot from USB 0:1 to /dev/sda1 FS;usb=/dev/sda1;part=0:1;dir=/boot;; \
	usb_sdb1=6.  Boot from USB 1:1 to /dev/sdb1 FS;usb=/dev/sdb1;part=1:1;dir=/boot;; \
	sata_ram=7.  Boot from SATA 0:1 to initrd;usb=initfs;part=0:1;dir=/;; \
	sata_sda1=8.  Boot from SATA 0:1 to /dev/sda1 FS;sata=/dev/sda1;part=0:1;dir=/boot;; \
	sata_sdb1=9.  Boot from SATA 1:1 to /dev/sdb1 FS;sata=/dev/sdb1;part=1:1;dir=/boot;; \
	net_stat=10. Boot via TFTP (192.168.0.2/192.168.0.1) to initrd;tftp=initfs;ip=192.168.0.2;srvip=192.168.0.1;; \
	net_dhcp=11. Boot via TFTP (dhcp/192.168.0.1) to initrd;tftp=initfs;ip=dhcp;srvip=192.168.0.1;; \
	net_nfs=12. Boot via NFS (dhcp/192.168.0.1) to initrd;nfs=initfs;ip=dhcp;srvip=192.168.0.1;dir=/boot;; \
	reset=Reset board;reset \
"
UBOOT_ENV_MENU_MAIN = "rec_ram;;rec_sda1;;rec_sdb1;;usb_ram;;usb_sda1;;usb_sdb1;; \
                       sata_ram;;sata_sda1;;sata_sdb1;;net_stat;;net_dhcp;;net_nfs;; \
                       reset"
```

## conf/distro/tc-msbt2.conf
```bitbake
#@TYPE: Distro
#@NAME: Tclient MSBT2 MIPS
#@DESCRIPTION: Baikal-T1 based T-platforms Tclient MSBT2 board

require conf/distro/tc.conf

###################################################################################################
#                                   U-boot environment settings
###################################################################################################
UBOOT_ENV_CPUFREQ = "1200"
```

## conf/distro/tc-sfbt1.conf
```bitbake
#@TYPE: Distro
#@NAME: Tclient SFBT1 MIPS
#@DESCRIPTION: Baikal-T based T-platforms Tclient SFBT1 board

require conf/distro/tc.conf

###################################################################################################
#                                   U-boot environment settings
###################################################################################################
UBOOT_ENV_CPUFREQ = "850"
```
