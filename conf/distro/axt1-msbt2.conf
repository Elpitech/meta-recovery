## conf/distro/et402.conf
```bitbake
#@TYPE: Distro
#@NAME: ET402 MIPS
#@DESCRIPTION: Baikal-T1 based Elpitech ET402 module

###################################################################################################
#                                   U-boot environment settings
###################################################################################################
UBOOT_ENV_CPUFREQ = "1200"
UBOOT_ENV_BOOTDELAY = "5"
UBOOT_ENV_BOOTCMD = "run bootrecovery"
UBOOT_ENV_BOOTUNITS = "rec_ram=1. Boot recovery kernel and RFS;rom=initfs;; \
                       reset=Reset board;reset"
#UBOOT_ENV_MENU_MAIN = "rec_ram;;reset"
UBOOT_ENV_MENU_MAIN = ""
UBOOT_ENV_FITIMAGE_ADDR_FW = ""
UBOOT_ENV_VMLINUX_FILE_NAME = ""
UBOOT_ENV_VMLINUZ_FILE_NAME = ""
UBOOT_ENV_VMLINUX_ADDR_LD = ""
UBOOT_ENV_VMLINUZ_ADDR_LD = ""
UBOOT_ENV_INITRD_HIGH = "ffffffff"
UBOOT_ENV_EXTRA_VARS = "bootnormal=run usb_boot\n\
bootrecovery=run setroot_rec_ram collect_args; sf probe; mtd read fitimage \${multi_addr_ld}; bootm \${multi_addr_ld}\${multi_conf}\n\
res0=true\nres1=false\nifok=run res\$?\n\
all_bootm=bootm \${kernel_addr_ld} \${initrd_addr} \${fdt_addr_ld}\n\
boot_bootconf=run load_bootconf load_fdt load_kernel load_initrd; run ifok all_bootm\n\
sata_boot=run scsi_boot\n\
usb_boot=usb start; setenv boot_dev usb; setenv boot_idx 0:1; run boot_bootconf\n\
load_bootconf=load \${boot_dev} \${boot_idx} \${fdt_addr_ld} bootconf2; bootconf \${fdt_addr_ld} \${filesize}\n\
load_kernel=echo Loading kernel: \${image_name}; load \${boot_dev} \${boot_idx} \${kernel_addr_ld} \${image_name}\n\
load_initrd=echo Loading ramdisk: \${initrd_name}; setenv initrd_addr -; load \${boot_dev} \${boot_idx} \${initrd_addr_ld} \${initrd_name}; run ifok set_initrd; true\n\
load_fdt=echo Loading FDT: \${fdt_name}; load \${boot_dev} \${boot_idx} \${fdt_addr_ld} \${fdt_name}; fdt addr \${fdt_addr_ld}\n\
multi_addr_ld=85000000\n\
kernel_addr_ld=0x86100000\n\
scsi_boot=setenv boot_dev scsi; setenv boot_idx 0:1; run boot_bootconf\n\
set_initrd=setenv initrd_addr \${initrd_addr_ld}; setenv initrd_size \${filesize}"
UBOOT_ENV_EXTRA_ARGS = "usbcore.autosuspend=-1 consoleblank=0"
UBOOT_ENV_ETHADDR = ""
UBOOT_ENV_ETH1ADDR = ""
UBOOT_ENV_ETH2ADDR = ""

RECOVERY_SETPASS = "y"
SERIAL_CONSOLES = "115200;ttyS0 0;tty1 0;tty2 0;tty3 0;tty4"
RECOVERY_IMAGE_EXTRA_INSTALL = "ethtool btflash"
RECOVERY_IMAGE_TEST_BENCHES = "memtester"
#RECOVERY_IMAGE_EXTRA_INSTALL:append = " tcpdump ntp util-linux-uuidgen libmitxfru pigz"
INITRAMFS_MAXSIZE = "54000"

RECOVERY_PWD_ROOT = "1"
```

## conf/distro/et412.conf
```bitbake
#@TYPE: Distro
#@NAME: ET412 MIPS
#@DESCRIPTION: Baikal-T1 based Elpitech et412 board

###################################################################################################
#                                   U-boot environment settings
###################################################################################################
UBOOT_ENV_CPUFREQ = "1200"
UBOOT_ENV_BOOTDELAY = "3"
UBOOT_ENV_BOOTCMD = "run bootrecovery"
UBOOT_ENV_INITRD_HIGH = "ffffffff"
UBOOT_ENV_BOOTUNITS = ""
UBOOT_ENV_MENU_MAIN = ""
UBOOT_ENV_EXTRA_VARS = "bootnormal=run usb_boot\n\
bootrecovery=run setroot_rec_ram collect_args; sf probe; mtd read fitimage \${multi_addr_ld}; bootm \${multi_addr_ld}\${multi_conf}\n\
setroot_rec_ram=setenv root_dev initfs\n\
res0=true\nres1=false\nifok=run res\$?\n\
all_bootm=bootm \${kernel_addr_ld} \${initrd_addr} \${fdt_addr_ld}\n\
boot_bootconf=run load_bootconf load_fdt load_kernel load_initrd; run ifok all_bootm\n\
sata_boot=run scsi_boot\n\
usb_boot=usb start; setenv boot_dev usb; setenv boot_idx 0:1; run boot_bootconf\n\
load_bootconf=load \${boot_dev} \${boot_idx} \${fdt_addr_ld} bootconf2; bootconf \${fdt_addr_ld} \${filesize}\n\
load_kernel=echo Loading kernel: \${image_name}; load \${boot_dev} \${boot_idx} \${kernel_addr_ld} \${image_name}\n\
load_initrd=echo Loading ramdisk: \${initrd_name}; setenv initrd_addr -; load \${boot_dev} \${boot_idx} \${initrd_addr_ld} \${initrd_name}; run ifok set_initrd; true\n\
load_fdt=echo Loading FDT: \${fdt_name}; load \${boot_dev} \${boot_idx} \${fdt_addr_ld} \${fdt_name}; fdt addr \${fdt_addr_ld}\n\
multi_addr_ld=85000000\n\
kernel_addr_ld=0x86100000\n\
scsi_boot=setenv boot_dev scsi; setenv boot_idx 0:1; run boot_bootconf\n\
set_initrd=setenv initrd_addr \${initrd_addr_ld}; setenv initrd_size \${filesize}"
UBOOT_ENV_EXTRA_ARGS = " console=tty2 usbcore.autosuspend=-1 consoleblank=0"

# Theses are not used in u-boot 2019-2021 
UBOOT_ENV_VMLINUZ_FILE_NAME = ""
UBOOT_ENV_VMLINUX_FILE_NAME = ""
UBOOT_ENV_VMLINUZ_FILE_NAME = ""
UBOOT_ENV_VMLINUX_FILE_NAME = ""

RECOVERY_SETPASS = "y"
SERIAL_CONSOLES = "115200;ttyS0 0;tty2 0;tty3 0;tty4"
RECOVERY_IMAGE_EXTRA_INSTALL:append = " util-linux-uuidgen libmitxfru pigz"
# We will run out of space if we add tcpdump and ntp. Check what can be removed
# in firmware.inc if you really need them.
RECOVERY_IMAGE_EXTRA_INSTALL:append = " strace udev btflash"

# Add more tests from firmware.inci, if needed
RECOVERY_IMAGE_TEST_BENCHES = "memtester"

INITRAMFS_MAXSIZE = "50000"

###################################################################################################
#                                     Recovery image settings
###################################################################################################
RECOVERY_PWD_ROOT = "1"

INITSCRIPT_PARAMS_dropbear = "start 80 S ."
DROPBEAR_ALLOW_ROOT = "y"
RECOVERY_AUTO_INTERFACES = "eth0"
UBOOT_ENV_ETHADDR = ""
UBOOT_ENV_ETH1ADDR = ""
UBOOT_ENV_ETH2ADDR = ""
```
