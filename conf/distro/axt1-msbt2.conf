## conf/distro/axt1-msbt2.conf
```bitbake
#@TYPE: Distro
#@NAME: Axitech v1 MSBT2 MIPS
#@DESCRIPTION: Baikal-T1 based T-platforms Axitech v1 MSBT2 board

require conf/distro/axt1.conf

###################################################################################################
#                                   U-boot environment settings
###################################################################################################
UBOOT_ENV_CPUFREQ = "1200"
```

## conf/distro/axt1-sfbt1.conf
```bitbake
#@TYPE: Distro
#@NAME: Axitech v1 SFBT1 MIPS
#@DESCRIPTION: Baikal-T based T-platforms Axitech v1 SFBT1 board

require conf/distro/axt1.conf

###################################################################################################
#                                   U-boot environment settings
###################################################################################################
UBOOT_ENV_CPUFREQ = "850"
```

## conf/distro/azure.conf
```bitbake
#@TYPE: Distro
#@NAME: Azure MIPS
#@DESCRIPTION: Baikal-T1 based T-platforms Azure switch

###################################################################################################
#                                   U-boot environment settings
###################################################################################################
UBOOT_ENV_CPUFREQ = "1200"
UBOOT_ENV_BOOTDELAY = "3"
UBOOT_ENV_BOOTCMD = "run usb_boot"
UBOOT_ENV_BOOTUNITS = "rec_ram=1. Boot recovery kernel and RFS;rom=initfs;; \
                       reset=Reset board;reset"
UBOOT_ENV_MENU_MAIN = ""
UBOOT_ENV_FITIMAGE_ADDR_FW = ""
UBOOT_ENV_VMLINUX_FILE_NAME = ""
UBOOT_ENV_VMLINUZ_FILE_NAME = ""
UBOOT_ENV_VMLINUX_ADDR_LD = ""
UBOOT_ENV_VMLINUZ_ADDR_LD = ""
UBOOT_ENV_ETHADDR = "7a:72:6c:4a:7a:07"
UBOOT_ENV_ETH1ADDR = "7a:72:6c:4a:7b:07"
UBOOT_ENV_INITRD_HIGH = "ffffffff"
UBOOT_ENV_EXTRA_VARS = "bootnormal=run usb_boot\n\
bootrecovery=run setroot_rec_ram collect_args; sf probe; mtd read fitimage \${multi_addr_ld}; bootm \${multi_addr_ld}\${multi_conf}\n\
res0=true\nres1=false\nifok=run res\$?\n\
all_bootm=bootm \${kernel_addr_ld} \${initrd_addr} \${fdt_addr_ld}\n\
boot_bootconf=run load_bootconf load_fdt load_kernel load_initrd; run ifok all_bootm; run bootrecovery\n\
sata_boot=run scsi_boot\n\
usb_boot=usb start; setenv boot_dev usb; setenv boot_idx 0:1; run boot_bootconf\n\
load_bootconf=load \${boot_dev} \${boot_idx} \${fdt_addr_ld} bootconf2; bootconf \${fdt_addr_ld} \${filesize}\n\
load_kernel=echo Loading kernel: \${image_name}; load \${boot_dev} \${boot_idx} \${kernel_addr_ld} \${image_name}\n\
load_initrd=echo Loading ramdisk: \${initrd_name}; setenv initrd_addr -; load \${boot_dev} \${boot_idx} \${initrd_addr_ld} \${initrd_name}; run ifok set_initrd; true\n\
load_fdt=echo Loading FDT: \${fdt_name}; load \${boot_dev} \${boot_idx} \${fdt_addr_ld} \${fdt_name}; fdt addr \${fdt_addr_ld}\n\
multi_addr_ld=85000000\n\
kernel_addr_ld=0x86100000\n\
scsi_boot=setenv boot_dev scsi; setenv boot_idx 0:1; run boot_bootconf\n\
set_initrd=setenv initrd_addr \${initrd_addr_ld}; setenv initrd_size \${filesize}"
UBOOT_ENV_EXTRA_ARGS = "usbcore.autosuspend=-1 consoleblank=0"

RECOVERY_SETPASS = "y"
SERIAL_CONSOLES = "115200;ttyS0 0;tty1 0;tty2 0;tty3 0;tty4"
RECOVERY_IMAGE_EXTRA_INSTALL_append += "tcpdump net-tools ntp util-linux-uuidgen libmitxfru pigz btflash"
INITRAMFS_MAXSIZE = "44000"

###################################################################################################
#                                     Recovery image settings
###################################################################################################
RECOVERY_PWD_ROOT = "1"
```

## conf/distro/bc3bt1-mrbt1.conf
```bitbake
#@TYPE: Distro
#@NAME: Axitech BC3BT1 MRBT1 MIPS
#@DESCRIPTION: Baikal-T1 based T-platforms Axitech BC3BT1 MRBT1 board

###################################################################################################
#                                   U-boot environment settings
###################################################################################################
UBOOT_ENV_CPUFREQ = "1200"
UBOOT_ENV_BOOTDELAY = "5"
UBOOT_ENV_BOOTCMD = "run boot_sata_sda2"
UBOOT_ENV_BOOTUNITS = "\
	sata_sda2=1. Boot Debian from SATA port 0 (/dev/sda2);sata=/dev/sda2;part=0:1;dir=/;; \
	menu_rcvr=2. Open recovery menu;menu=recovery;; \
	rec_ram=1. Boot from flash to recovery FS;rom=initfs;; \
	rec_sda2=2. Boot from flash to /dev/sda2 FS;rom=/dev/sda2;; \
	rec_sdb1=3. Boot from flash to /dev/sdb1 FS;rom=/dev/sdb1;; \
	usb_ram=4. Boot from USB 0:1 to initrd;usb=initfs;part=0:1;dir=/;; \
	usb_sdb1=5. Boot from USB 0:1 to /dev/sdb1 FS;usb=/dev/sdb1;part=0:1;dir=/boot;; \
	net_stat=6. Boot via TFTP (192.168.0.2/192.168.0.1) to recovery FS;tftp=initfs;ip=192.168.0.2;srvip=192.168.0.1;; \
	net_dhcp=7. Boot via TFTP (dhcp/192.168.0.1) to recovery FS;tftp=initfs;ip=dhcp;srvip=192.168.0.1;; \
	net_nfs=8. Boot via NFS (dhcp/192.168.0.1) to recovery FS;nfs=initfs;ip=dhcp;srvip=192.168.0.1;dir=/boot;; \
	menu_main=Back to main menu;menu=main;; \
	reset=Reset board;reset \
"
UBOOT_ENV_MENU_MAIN = "sata_sda2;;menu_rcvr"
UBOOT_ENV_MENU_RCVR = "rec_ram;;rec_sda2;;rec_sdb1;; \
			usb_ram;;usb_sdb1;; \
			net_stat;;net_dhcp;;net_nfs;; \
			menu_main;;reset"

###################################################################################################
#                                     Recovery image settings
###################################################################################################
RECOVERY_PWD_ROOT = "axitech"
RECOVERY_IMAGE_EXTRA_INSTALL += "smstools3 smt-cp210x fwgen pulse-cntr"
RECOVERY_IMAGE_EXTRA_INSTALL_remove = "pciutils"
```

## conf/distro/bfk.conf
```bitbake
#@TYPE: Distro
#@NAME: BFK MIPS
#@DESCRIPTION: Baikal-T based Baikal BFK v1.0, v1.5, v1.6 evaluation boards

###################################################################################################
#                                   U-boot environment settings
###################################################################################################
UBOOT_ENV_CPUFREQ = "850"
```

## conf/distro/bfk3.conf
```bitbake
#@TYPE: Distro
#@NAME: BFK3 MIPS
#@DESCRIPTION: Baikal-T1 based Baikal BFK v2.0, v3.x evaluation boards

###################################################################################################
#                                   U-boot environment settings
###################################################################################################
UBOOT_ENV_CPUFREQ = "1200"
```

## conf/distro/bfkx.conf
```bitbake
#@TYPE: Distro
#@NAME: BFKx MIPS
#@DESCRIPTION: Baikal-T1 based Baikal BFK v1.6 evaluation boards

###################################################################################################
#                                   U-boot environment settings
###################################################################################################
UBOOT_ENV_CPUFREQ = "1200"
```

## conf/distro/bn1bt1.conf
```bitbake
#@TYPE: Distro
#@NAME: BN1BT1 MIPS
#@DESCRIPTION: Baikal-T1 based T-platforms BN1BT1 board

###################################################################################################
#                                   U-boot environment settings
###################################################################################################
UBOOT_ENV_CPUFREQ = "1200"
UBOOT_ENV_BOOTDELAY = "1"
UBOOT_ENV_BOOTCMD = "run bootnormal"
UBOOT_ENV_EXTRA_VARS = "bootnormal=run sata_boot\n\
boot_bootconf=run load_bootconf load_fdt load_kernel load_initrd; run all_bootnr\n\
sata_boot=sata init; setenv boot_dev sata; setenv boot_idx 0; run boot_bootconf\n\
usb_boot=usb start; setenv boot_dev usb; setenv boot_idx 0; run boot_bootconf\n\
mmc_speed=10000000\n\
mmc_boot=mmc_spi 0 \${mmc_speed}; setenv boot_dev mmc; setenv boot_idx 0; run boot_bootconf\n\
load_bootconf=load \${boot_dev} \${boot_idx} \${fdt_addr_ld} bootconf; service bootconf \${fdt_addr_ld} \${filesize}; sleep 1\n\
load_kernel=echo Loading kernel: \${kernel_file_name}; load \${boot_dev} \${boot_idx} \${kernel_addr_n} \${kernel_file_name}\n\
load_initrd=echo Loading ramdisk: \${initrd_file_name}; load \${boot_dev} \${boot_idx} \${initrd_addr_ld} \${initrd_file_name}; setenv initrd_len \${filesize}\n\
load_fdt=echo Loading FDT: \${fdt_file_name}; load \${boot_dev} \${boot_idx} \${fdt_addr_ld} \${fdt_file_name}; fdt addr \${fdt_addr_ld}\n\
all_bootnr=bootnr \${kernel_addr_r} \${initrd_addr_ld} \${fdt_addr_ld}\n\
bootrecovery=run boot_rec_ram"
UBOOT_ENV_EXTRA_ARGS = "console=tty1"

###################################################################################################
#                                     Recovery image settings
###################################################################################################
SERIAL_CONSOLES = "115200;ttyS0 0;tty1 0;tty2 0;tty3 0;tty4"
RECOVERY_PWD_ROOT = "1"
RECOVERY_IMAGE_EXTRA_INSTALL += "serkbd kernel-module-ttm kernel-module-radeon realtek-fw terminus-font-consolefonts linux-firmware-radeon-oland"
KERNEL_MODULE_AUTOLOAD   += "radeon"
KERNEL_MODULE_PROBECONF  += "radeon"
module_conf_radeon = "options radeon dpm=0 auxch=0"
RECOVERY_FONT = "ter-132b.psf.gz"
RECOVERY_SERIO_LINE = "ttyS1"
```

## conf/distro/cnc-msbt2.conf
```bitbake
#@TYPE: Distro
#@NAME: CNC MSBT2 MIPS
#@DESCRIPTION: Baikal-T1 based T-platforms CNC MSBT2 boards

require conf/distro/cnc.conf

###################################################################################################
#                                   U-boot environment settings
###################################################################################################
UBOOT_ENV_CPUFREQ = "1200"

###################################################################################################
#                                   U-boot environment settings
###################################################################################################
UBOOT_ENV_BOOTUNITS = "\
	rec_ram=1. Boot from flash to initrd;rom=initfs;; \
	rec_sda1=2. Boot from flash to /dev/sda1 FS;rom=/dev/sda1;; \
	rec_sdc1=3. Boot from flash to /dev/sdc1 FS;rom=/dev/sdc1;; \
	usb_ram=4. Boot from USB fat 0:1 to initrd;usb=initfs;fs=fat;part=0:1;dir=/;; \
	usb_sda1=5. Boot from USB ext 0:1 to /dev/sda1 FS;usb=/dev/sda1;fs=ext;part=0:1;dir=/boot;; \
	usb_sdc1=6. Boot from USB ext 0:1 to /dev/sdc1 FS;usb=/dev/sdc1;fs=ext;part=0:1;dir=/boot;; \
	net_stat=7. Boot via TFTP (192.168.0.2/192.168.0.1) to initrd;tftp=initfs;ip=192.168.0.2;srvip=192.168.0.1;; \
	net_dhcp=8. Boot via TFTP (dhcp/192.168.0.1) to initrd;tftp=initfs;ip=dhcp;srvip=192.168.0.1;; \
	net_nfs=9. Boot via NFS (dhcp/192.168.0.1) to initrd;nfs=initfs;ip=dhcp;srvip=192.168.0.1;dir=/boot;; \
	reset=Reset board;reset \
"
UBOOT_ENV_MENU_MAIN = "rec_ram;;rec_sda1;;rec_sdc1;;usb_ram;;usb_sda1;;usb_sdc1;; \
			net_stat;;net_dhcp;;net_nfs;;reset"
```

## conf/distro/cnc-sfbt1.conf
```bitbake
#@TYPE: Distro
#@NAME: CNC SFBT1 MIPS
#@DESCRIPTION: Baikal-T based T-platforms CNC SFBT1 boards

require conf/distro/cnc.conf

###################################################################################################
#                                   U-boot environment settings
###################################################################################################
UBOOT_ENV_CPUFREQ = "850"

###################################################################################################
#                                   U-boot environment settings
###################################################################################################
UBOOT_ENV_BOOTUNITS = "\
	rec_ram=1. Boot from flash to initrd;rom=initfs;; \
	rec_sdb1=2. Boot from flash to /dev/sdb1 FS;rom=/dev/sdb1;; \
	rec_sdd1=3. Boot from flash to /dev/sdd1 FS;rom=/dev/sdd1;; \
	usb_ram=4. Boot from USB 1:1 to initrd;usb=initfs;part=1:1;dir=/;; \
	usb_sdb1=5. Boot from USB 1:1 to /dev/sdb1 FS;usb=/dev/sdb1;part=1:1;dir=/boot;; \
	usb_sdd1=6. Boot from USB 3:1 to /dev/sdd1 FS;usb=/dev/sdd1;part=3:1;dir=/boot;; \
	net_stat=7. Boot via TFTP (192.168.0.2/192.168.0.1) to initrd;tftp=initfs;ip=192.168.0.2;srvip=192.168.0.1;; \
	net_dhcp=8. Boot via TFTP (dhcp/192.168.0.1) to initrd;tftp=initfs;ip=dhcp;srvip=192.168.0.1;; \
	net_nfs=9. Boot via NFS (dhcp/192.168.0.1) to initrd;nfs=initfs;ip=dhcp;srvip=192.168.0.1;dir=/boot;; \
	reset=Reset board;reset \
"
UBOOT_ENV_MENU_MAIN = "rec_ram;;rec_sdb1;;rec_sdd1;;usb_ram;;usb_sdb1;;usb_sdd1;; \
			net_stat;;net_dhcp;;net_nfs;;reset"
```

## conf/distro/cnc.conf
```bitbake
###################################################################################################
#                                     Kernel private settings
###################################################################################################
LINUX_KERNEL_TYPE = "preempt-rt"

###################################################################################################
#                                   U-boot environment settings
###################################################################################################
UBOOT_ENV_BOOTDELAY = "3"
UBOOT_ENV_EXTRA_ARGS = "video=sm750fb:1280x720-32@60"

###################################################################################################
#                                     Recovery image settings
###################################################################################################
SERIAL_CONSOLES = "115200;ttyS0 ${@" ".join(['115200;ttyS%d' % (num*2 + 1) for num in range(18)])}"
RECOVERY_PWD_ROOT = "cncware"
RECOVERY_IMAGE_EXTRA_INSTALL += "smt-89hpesx"
SERIAL_CONSOLES += "0;tty1 0;tty2 0;tty3"
```
