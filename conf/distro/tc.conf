## conf/distro/tc.conf
```bitbake
###################################################################################################
#                                   U-boot environment settings
###################################################################################################
UBOOT_ENV_BOOTDELAY = "3"
UBOOT_ENV_BOOTCMD = "run boot_sata_sda6"
UBOOT_ENV_BOOTUNITS = "\
	sata_sda6=1. Boot Debian from SATA port 0 (/dev/sda6);sata=/dev/sda6;fs=ext;part=0:1;dir=/;; \
	menu_rcvr=2. Open recovery menu;menu=recovery;; \
	rec_ram=1. Boot from flash to recovery FS;rom=initfs;; \
	rec_sda6=2. Boot from flash to /dev/sda6 FS;rom=/dev/sda6;; \
	rec_sdb1=3. Boot from flash to /dev/sdb1 FS;rom=/dev/sdb1;; \
	usb_ram=4. Boot from USB fat 0:1 to recovery FS;usb=initfs;fs=fat;part=0:1;dir=/boot;; \
	usb_sdb1=5. Boot from USB ext 0:1 to /dev/sdb1 FS;usb=/dev/sdb1;fs=ext;part=0:1;dir=/boot;; \
	sata_sdb1=6. Boot from SATA ext 0:1 to /dev/sdb1 FS;sata=/dev/sdb1;fs=ext;part=0:1;dir=/boot;; \
	net_stat=7. Boot via TFTP (192.168.0.2/192.168.0.1) to recovery FS;tftp=initfs;ip=192.168.0.2;srvip=192.168.0.1;; \
	net_dhcp=8. Boot via TFTP (dhcp/192.168.0.1) to recovery FS;tftp=initfs;ip=dhcp;srvip=192.168.0.1;; \
	net_nfs=9. Boot via NFS (dhcp/192.168.0.1) to recovery FS;nfs=initfs;ip=dhcp;srvip=192.168.0.1;dir=/boot;; \
	menu_main=Back to main menu;menu=main;; \
	reset=Reset board;reset \
"
UBOOT_ENV_MENU_MAIN = "sata_sda6;;menu_rcvr"
UBOOT_ENV_MENU_RCVR = "rec_ram;;rec_sda6;;rec_sdb1;; \
			usb_ram;;usb_sdb1;;sata_sdb1;; \
			net_stat;;net_dhcp;;net_nfs;; \
			menu_main;;reset"
```

## conf/layer.conf
```bitbake
# We have a conf and classes directory, add to BBPATH
BBPATH .= ":${LAYERDIR}"

# We have recipes-* directories, add to BBFILES
BBFILES += "${LAYERDIR}/recipes-*/*/*.bb \
            ${LAYERDIR}/recipes-*/*/*.bbappend"

BBFILE_COLLECTIONS += "recovery"
BBFILE_PATTERN_recovery = "^${LAYERDIR}/"
BBFILE_PRIORITY_recovery = "6"

LAYERDEPENDS_recovery = "core baikal-t openembedded-layer"

LAYERSERIES_COMPAT_recovery = "rocko sumo"
```
